## conf/layer.conf
```bitbake
# We have a conf and classes directory, add to BBPATH
BBPATH .= ":${LAYERDIR}"

# We have recipes-* directories, add to BBFILES
BBFILES += "${LAYERDIR}/recipes-*/*/*.bb \
	${LAYERDIR}/recipes-*/*/*.bbappend"

BBFILE_COLLECTIONS += "meta-rpi-fbcp"
BBFILE_PATTERN_meta-rpi-fbcp = "^${LAYERDIR}/"
BBFILE_PRIORITY_meta-rpi-fbcp = "11"

LAYERDEPENDS_pitft35-rpi = "pitft35-rpi"
```
